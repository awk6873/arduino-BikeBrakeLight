/* 2023-04-17T20:23:28Z */

/* ----------------------------------------------------------------------
Copyright (c) 2022-2023 Neuton.AI, Inc.
*
The source code and its binary form are being made available on the following terms:
Redistribution, use, and modification are permitted provided that the following
conditions are met:
*
1. Redistributions of source code and/or its binary form must retain the above copyright notice,
* this list of conditions (and the disclaimer) either in the body of the source code or in
* the documentation and/or other materials provided with the distribution of the binary form, as
applicable.
*
2. The name of the copyright holder may not be used to endorse or promote products derived from this
* source code or its binary form without specific prior written permission of Neuton.AI, Inc.
*
3. Disclaimer. THIS SOURCE CODE AND ITS BINARY FORM ARE PROVIDED BY THE COPYRIGHT HOLDER "AS IS".
* THE COPYRIGHT HOLDER HEREBY DISCLAIMS ANY EXPRESS OR IMPLIED WARRANTIES, INCLUDING,
* BUT NOT LIMITED TO, THE IMPLIED WARRANTIES OF MERCHANTABILITY AND FITNESS FOR A
* PARTICULAR PURPOSE. IN NO EVENT SHALL THE COPYRIGHT HOLDER BE HELD LIABLE
* FOR ANY DIRECT, INDIRECT, INCIDENTAL, SPECIAL, EXEMPLARY, OR CONSEQUENTIAL
* DAMAGES (INCLUDING, BUT NOT LIMITED TO, PROCUREMENT OF SUBSTITUTE GOODS OR
* SERVICES; LOSS OF USE, DATA, OR PROFITS; INFRINGEMENT OF INTELLECTUAL PROPERTY RIGHTS
* OF THIRD PARTIES; OR BUSINESS INTERRUPTION) HOWEVER CAUSED AND ON ANY THEORY OF LIABILITY,
* WHETHER IN CONTRACT, STRICT LIABILITY, OR TORT (INCLUDING NEGLIGENCE OR OTHERWISE) ARISING
* IN ANY WAY OUT OF THE USE OF THIS SOURCE CODE OR ITS BINARY FORM, EVEN IF ADVISED OF THE
* POSSIBILITY OF SUCH DAMAGE.
---------------------------------------------------------------------- */


static const neuton_weight_t MODEL_WEIGHTS[] = {
	-32448, 29050, 32763, 2802, 13922, -2845, -9890, 29078, -19780, -30839,
	32567, 578, -1745, -2427, -26093, -20926, 32755, 8357, -145, -17590, 6943,
	-32768, 22531, -23071, -574, 23561, 7195, -2830, -21491, -32755, -16355,
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	-8293, 12303, -32768, -32768, 6668, -18919, -29326, 32765, 3736 };

static const neuton_sources_num_t MODEL_LINKS[] = {
	1, 3, 11, 23, 24, 46, 71, 0, 1, 43, 52, 67, 71, 3, 9, 15, 52, 62, 71, 2,
	2, 43, 59, 61, 71, 1, 3, 10, 32, 43, 71, 2, 3, 34, 53, 65, 69, 71, 4, 11,
	12, 14, 49, 68, 71, 11, 32, 34, 37, 51, 71, 5, 7, 29, 32, 37, 69, 71, 1,
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	23, 24, 25, 26, 27, 28, 29, 71 };

static const neuton_weights_num_t MODEL_INTERNAL_LINKS_BOUNDARIES[] = {
	0, 8, 13, 20, 27, 32, 39, 45, 52, 59, 66, 71, 78, 84, 92, 97, 105, 111,
	128, 133, 138, 146, 151, 158, 165, 173, 181, 187, 193, 200, 222 };

static const neuton_weights_num_t MODEL_EXTERNAL_LINKS_BOUNDARIES[] = {
	7, 13, 19, 25, 31, 38, 45, 51, 58, 64, 71, 78, 84, 90, 97, 103, 109, 115,
	129, 136, 143, 150, 157, 164, 172, 179, 186, 192, 199, 206, 223 };

static const neuton_coeff_t MODEL_ACTIVATION_COEFFS[] = {
	40956, 15292, 40959, 40957, 40957, 35790, 15774, 22082, 40960, 40930, 40658,
	40928, 30743, 40952, 40960, 40932, 40939, 40634, 31060, 30390, 40920, 28142,
	39639, 40932, 40960, 40958, 40932, 36792, 40958, 40957, 40960 };

static const neuton_neurons_num_t MODEL_OUTPUT_NEURONS[] = { 18, 30 };

