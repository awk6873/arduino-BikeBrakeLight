/* 2023-03-26T15:51:15Z */

/* ----------------------------------------------------------------------
Copyright (c) 2022-2023 Neuton.AI, Inc.
*
The source code and its binary form are being made available on the following terms:
Redistribution, use, and modification are permitted provided that the following
conditions are met:
*
1. Redistributions of source code and/or its binary form must retain the above copyright notice,
* this list of conditions (and the disclaimer) either in the body of the source code or in
* the documentation and/or other materials provided with the distribution of the binary form, as
applicable.
*
2. The name of the copyright holder may not be used to endorse or promote products derived from this
* source code or its binary form without specific prior written permission of Neuton.AI, Inc.
*
3. Disclaimer. THIS SOURCE CODE AND ITS BINARY FORM ARE PROVIDED BY THE COPYRIGHT HOLDER "AS IS".
* THE COPYRIGHT HOLDER HEREBY DISCLAIMS ANY EXPRESS OR IMPLIED WARRANTIES, INCLUDING,
* BUT NOT LIMITED TO, THE IMPLIED WARRANTIES OF MERCHANTABILITY AND FITNESS FOR A
* PARTICULAR PURPOSE. IN NO EVENT SHALL THE COPYRIGHT HOLDER BE HELD LIABLE
* FOR ANY DIRECT, INDIRECT, INCIDENTAL, SPECIAL, EXEMPLARY, OR CONSEQUENTIAL
* DAMAGES (INCLUDING, BUT NOT LIMITED TO, PROCUREMENT OF SUBSTITUTE GOODS OR
* SERVICES; LOSS OF USE, DATA, OR PROFITS; INFRINGEMENT OF INTELLECTUAL PROPERTY RIGHTS
* OF THIRD PARTIES; OR BUSINESS INTERRUPTION) HOWEVER CAUSED AND ON ANY THEORY OF LIABILITY,
* WHETHER IN CONTRACT, STRICT LIABILITY, OR TORT (INCLUDING NEGLIGENCE OR OTHERWISE) ARISING
* IN ANY WAY OUT OF THE USE OF THIS SOURCE CODE OR ITS BINARY FORM, EVEN IF ADVISED OF THE
* POSSIBILITY OF SUCH DAMAGE.
---------------------------------------------------------------------- */


static const neuton_weight_t MODEL_WEIGHTS[] = {
	-15789, 30894, 23459, -32766, 4495, 11968, 14655, 20508, 21213, 17214,
	-28769, -18586, 1687, -17841, -12845, 29131, 13852, -9414, -11005, -8655,
	31922, -25423, -401, 17728, -6411, -32768, -8434, -32768, 32253, -22838,
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	18656, -32768, 16399, -24497, -32768, -7880, 15648, -32765, 29543, 5135 };

static const neuton_sources_num_t MODEL_LINKS[] = {
	0, 11, 20, 44, 69, 74, 0, 3, 13, 21, 38, 55, 74, 1, 3, 20, 39, 62, 74,
	7, 11, 20, 24, 51, 74, 10, 40, 46, 51, 58, 74, 2, 4, 7, 40, 61, 74, 3,
	5, 17, 31, 41, 72, 74, 1, 4, 14, 39, 52, 74, 11, 33, 48, 49, 57, 74, 11,
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	6, 8, 10, 12, 22, 23, 24, 25, 26, 27, 28, 29, 30, 74 };

static const neuton_weights_num_t MODEL_INTERNAL_LINKS_BOUNDARIES[] = {
	0, 7, 14, 19, 25, 33, 39, 46, 50, 56, 62, 70, 76, 84, 89, 96, 101, 108,
	114, 119, 125, 145, 151, 155, 163, 168, 174, 180, 188, 195, 201, 224 };

static const neuton_weights_num_t MODEL_EXTERNAL_LINKS_BOUNDARIES[] = {
	6, 13, 19, 25, 31, 37, 44, 50, 56, 62, 69, 76, 82, 88, 94, 101, 107, 113,
	119, 125, 131, 146, 153, 160, 166, 172, 178, 185, 192, 201, 208, 225 };

static const neuton_coeff_t MODEL_ACTIVATION_COEFFS[] = {
	40935, 30421, 14099, 40960, 40957, 40959, 27705, 23775, 39450, 40282, 40927,
	35824, 40843, 30631, 40919, 27462, 40932, 40421, 40887, 40950, 40932, 19251,
	40960, 9676, 40957, 40194, 40931, 19668, 40957, 39018, 40926, 31152 };

static const neuton_neurons_num_t MODEL_OUTPUT_NEURONS[] = { 31, 21 };

