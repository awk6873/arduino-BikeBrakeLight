/* 2023-04-16T22:27:58Z */

/* ----------------------------------------------------------------------
Copyright (c) 2022-2023 Neuton.AI, Inc.
*
The source code and its binary form are being made available on the following terms:
Redistribution, use, and modification are permitted provided that the following
conditions are met:
*
1. Redistributions of source code and/or its binary form must retain the above copyright notice,
* this list of conditions (and the disclaimer) either in the body of the source code or in
* the documentation and/or other materials provided with the distribution of the binary form, as
applicable.
*
2. The name of the copyright holder may not be used to endorse or promote products derived from this
* source code or its binary form without specific prior written permission of Neuton.AI, Inc.
*
3. Disclaimer. THIS SOURCE CODE AND ITS BINARY FORM ARE PROVIDED BY THE COPYRIGHT HOLDER "AS IS".
* THE COPYRIGHT HOLDER HEREBY DISCLAIMS ANY EXPRESS OR IMPLIED WARRANTIES, INCLUDING,
* BUT NOT LIMITED TO, THE IMPLIED WARRANTIES OF MERCHANTABILITY AND FITNESS FOR A
* PARTICULAR PURPOSE. IN NO EVENT SHALL THE COPYRIGHT HOLDER BE HELD LIABLE
* FOR ANY DIRECT, INDIRECT, INCIDENTAL, SPECIAL, EXEMPLARY, OR CONSEQUENTIAL
* DAMAGES (INCLUDING, BUT NOT LIMITED TO, PROCUREMENT OF SUBSTITUTE GOODS OR
* SERVICES; LOSS OF USE, DATA, OR PROFITS; INFRINGEMENT OF INTELLECTUAL PROPERTY RIGHTS
* OF THIRD PARTIES; OR BUSINESS INTERRUPTION) HOWEVER CAUSED AND ON ANY THEORY OF LIABILITY,
* WHETHER IN CONTRACT, STRICT LIABILITY, OR TORT (INCLUDING NEGLIGENCE OR OTHERWISE) ARISING
* IN ANY WAY OUT OF THE USE OF THIS SOURCE CODE OR ITS BINARY FORM, EVEN IF ADVISED OF THE
* POSSIBILITY OF SUCH DAMAGE.
---------------------------------------------------------------------- */


static const neuton_weight_t MODEL_WEIGHTS[] = {
	-32768, 28724, 30856, 353, -3576, 636, 24009, -17903, -9529, 3280, 26690,
	-13435, 3933, 20399, -15606, -32768, -32768, 20292, -32766, 9764, 628,
	22523, 9530, -32768, -27112, -26666, -566, -4366, -13948, -15197, -18076,
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	16658, -8663, -13481 };

static const neuton_sources_num_t MODEL_LINKS[] = {
	2, 9, 13, 33, 62, 100, 0, 2, 3, 62, 71, 78, 100, 0, 5, 6, 49, 87, 98, 99,
	100, 2, 5, 6, 9, 94, 100, 3, 10, 17, 69, 71, 95, 100, 4, 17, 23, 52, 72,
	100, 1, 43, 51, 72, 85, 86, 100, 0, 2, 18, 37, 50, 56, 100, 2, 4, 7, 48,
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	50, 51, 52, 53, 54, 55, 56, 57, 58, 59, 60, 61, 62, 63, 64, 100 };

static const neuton_weights_num_t MODEL_INTERNAL_LINKS_BOUNDARIES[] = {
	0, 7, 13, 22, 28, 35, 41, 49, 57, 63, 67, 74, 82, 86, 94, 101, 106, 115,
	121, 127, 133, 139, 147, 155, 161, 170, 177, 183, 189, 196, 201, 207, 215,
	221, 227, 236, 241, 249, 255, 259, 265, 272, 278, 286, 294, 301, 307, 315,
	322, 370, 377, 383, 389, 396, 401, 408, 416, 425, 430, 435, 445, 452, 456,
	464, 471, 494 };

static const neuton_weights_num_t MODEL_EXTERNAL_LINKS_BOUNDARIES[] = {
	6, 13, 21, 27, 34, 40, 47, 54, 61, 67, 73, 79, 86, 93, 99, 106, 114, 120,
	126, 133, 139, 147, 154, 161, 169, 176, 182, 188, 194, 201, 207, 213, 219,
	226, 233, 239, 246, 253, 259, 265, 271, 277, 285, 292, 299, 305, 312, 319,
	326, 371, 379, 386, 392, 399, 406, 413, 420, 427, 433, 439, 448, 455, 461,
	468, 474, 495 };

static const neuton_coeff_t MODEL_ACTIVATION_COEFFS[] = {
	40936, 18171, 40959, 39163, 40940, 38182, 40909, 40959, 40958, 21249, 40623,
	40958, 40933, 40960, 40926, 40958, 40960, 40956, 40960, 40946, 40952, 40960,
	40950, 40957, 40958, 40958, 40905, 40957, 40932, 40959, 40960, 40918, 40864,
	40931, 40957, 40958, 40209, 38356, 40960, 40954, 40957, 40959, 40919, 40919,
	40948, 40960, 40919, 24357, 40960, 40960, 40957, 31792, 35224, 36079, 40759,
	35810, 40960, 33409, 38379, 40959, 28163, 30744, 40923, 40959, 27817, 40960 };

static const neuton_neurons_num_t MODEL_OUTPUT_NEURONS[] = { 65, 49 };

