/* 2023-03-24T06:58:42Z */

/* ----------------------------------------------------------------------
Copyright (c) 2022-2023 Neuton.AI, Inc.
*
The source code and its binary form are being made available on the following terms:
Redistribution, use, and modification are permitted provided that the following
conditions are met:
*
1. Redistributions of source code and/or its binary form must retain the above copyright notice,
* this list of conditions (and the disclaimer) either in the body of the source code or in
* the documentation and/or other materials provided with the distribution of the binary form, as
applicable.
*
2. The name of the copyright holder may not be used to endorse or promote products derived from this
* source code or its binary form without specific prior written permission of Neuton.AI, Inc.
*
3. Disclaimer. THIS SOURCE CODE AND ITS BINARY FORM ARE PROVIDED BY THE COPYRIGHT HOLDER "AS IS".
* THE COPYRIGHT HOLDER HEREBY DISCLAIMS ANY EXPRESS OR IMPLIED WARRANTIES, INCLUDING,
* BUT NOT LIMITED TO, THE IMPLIED WARRANTIES OF MERCHANTABILITY AND FITNESS FOR A
* PARTICULAR PURPOSE. IN NO EVENT SHALL THE COPYRIGHT HOLDER BE HELD LIABLE
* FOR ANY DIRECT, INDIRECT, INCIDENTAL, SPECIAL, EXEMPLARY, OR CONSEQUENTIAL
* DAMAGES (INCLUDING, BUT NOT LIMITED TO, PROCUREMENT OF SUBSTITUTE GOODS OR
* SERVICES; LOSS OF USE, DATA, OR PROFITS; INFRINGEMENT OF INTELLECTUAL PROPERTY RIGHTS
* OF THIRD PARTIES; OR BUSINESS INTERRUPTION) HOWEVER CAUSED AND ON ANY THEORY OF LIABILITY,
* WHETHER IN CONTRACT, STRICT LIABILITY, OR TORT (INCLUDING NEGLIGENCE OR OTHERWISE) ARISING
* IN ANY WAY OUT OF THE USE OF THIS SOURCE CODE OR ITS BINARY FORM, EVEN IF ADVISED OF THE
* POSSIBILITY OF SUCH DAMAGE.
---------------------------------------------------------------------- */


static const neuton_weight_t MODEL_WEIGHTS[] = {
	-32761, 29322, 29036, -5422, -8238, -156, 30666, -12769, 32507, -28672,
	-10644, 6723, -28302, -31491, 25337, 7974, 32755, 1782, 19490, -25290,
	23704, 28826, -32762, -32742, -970, 32765, -28673, -32768, -32768, -32768,
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	-24286, -11356, 17264, -8501, 12595, -32768, -9677, -10408, -27527, 9346,
	13819 };

static const neuton_sources_num_t MODEL_LINKS[] = {
	1, 4, 12, 27, 39, 83, 0, 19, 50, 66, 81, 83, 4, 52, 61, 80, 82, 83, 2,
	9, 11, 38, 63, 68, 83, 12, 16, 19, 37, 76, 83, 4, 4, 15, 28, 45, 62, 83,
	1, 3, 3, 8, 33, 83, 1, 6, 12, 44, 82, 83, 2, 30, 41, 47, 48, 61, 83, 3,
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	5, 7, 29, 30, 31, 32, 33, 34, 83 };

static const neuton_weights_num_t MODEL_INTERNAL_LINKS_BOUNDARIES[] = {
	0, 7, 12, 19, 25, 32, 40, 46, 50, 57, 65, 73, 78, 83, 93, 97, 102, 108,
	115, 126, 130, 136, 143, 150, 156, 161, 169, 173, 203, 210, 217, 223, 228,
	234, 243, 256 };

static const neuton_weights_num_t MODEL_EXTERNAL_LINKS_BOUNDARIES[] = {
	6, 12, 18, 25, 31, 38, 44, 50, 57, 64, 71, 77, 83, 90, 96, 102, 108, 115,
	122, 129, 136, 142, 148, 155, 161, 167, 173, 179, 204, 212, 219, 226, 232,
	239, 246, 257 };

static const neuton_coeff_t MODEL_ACTIVATION_COEFFS[] = {
	40932, 17975, 40880, 40495, 30717, 26950, 30712, 28189, 40957, 40960, 36930,
	40958, 40930, 40957, 17940, 40940, 40955, 35185, 39678, 35410, 40946, 30717,
	35849, 40958, 40958, 40953, 40959, 40953, 40960, 38381, 21804, 38369, 35814,
	40957, 40927, 40932 };

static const neuton_neurons_num_t MODEL_OUTPUT_NEURONS[] = { 28, 35 };

