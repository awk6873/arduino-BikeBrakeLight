/* 2023-03-25T15:44:45Z */

/* ----------------------------------------------------------------------
Copyright (c) 2022-2023 Neuton.AI, Inc.
*
The source code and its binary form are being made available on the following terms:
Redistribution, use, and modification are permitted provided that the following
conditions are met:
*
1. Redistributions of source code and/or its binary form must retain the above copyright notice,
* this list of conditions (and the disclaimer) either in the body of the source code or in
* the documentation and/or other materials provided with the distribution of the binary form, as
applicable.
*
2. The name of the copyright holder may not be used to endorse or promote products derived from this
* source code or its binary form without specific prior written permission of Neuton.AI, Inc.
*
3. Disclaimer. THIS SOURCE CODE AND ITS BINARY FORM ARE PROVIDED BY THE COPYRIGHT HOLDER "AS IS".
* THE COPYRIGHT HOLDER HEREBY DISCLAIMS ANY EXPRESS OR IMPLIED WARRANTIES, INCLUDING,
* BUT NOT LIMITED TO, THE IMPLIED WARRANTIES OF MERCHANTABILITY AND FITNESS FOR A
* PARTICULAR PURPOSE. IN NO EVENT SHALL THE COPYRIGHT HOLDER BE HELD LIABLE
* FOR ANY DIRECT, INDIRECT, INCIDENTAL, SPECIAL, EXEMPLARY, OR CONSEQUENTIAL
* DAMAGES (INCLUDING, BUT NOT LIMITED TO, PROCUREMENT OF SUBSTITUTE GOODS OR
* SERVICES; LOSS OF USE, DATA, OR PROFITS; INFRINGEMENT OF INTELLECTUAL PROPERTY RIGHTS
* OF THIRD PARTIES; OR BUSINESS INTERRUPTION) HOWEVER CAUSED AND ON ANY THEORY OF LIABILITY,
* WHETHER IN CONTRACT, STRICT LIABILITY, OR TORT (INCLUDING NEGLIGENCE OR OTHERWISE) ARISING
* IN ANY WAY OUT OF THE USE OF THIS SOURCE CODE OR ITS BINARY FORM, EVEN IF ADVISED OF THE
* POSSIBILITY OF SUCH DAMAGE.
---------------------------------------------------------------------- */


static const neuton_weight_t MODEL_WEIGHTS[] = {
	-32768, 2220, 9968, 21429, 11764, 14209, 28874, -29090, 18804, -32763,
	-21109, 8693, -32698, -32000, 25494, 23576, -21797, 9462, 9583, 12149,
	-24088, 14091, -4715, 16349, -18864, -10696, -32768, 32719, -32767, -30350,
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	-13647, -20804, 10911, 32555, 32764, 14481, 7368, -869 };

static const neuton_sources_num_t MODEL_LINKS[] = {
	0, 5, 14, 16, 93, 97, 0, 3, 7, 15, 93, 97, 1, 5, 46, 54, 74, 81, 97, 2,
	8, 24, 28, 89, 96, 97, 3, 22, 24, 49, 54, 94, 97, 4, 68, 77, 79, 89, 97,
	1, 8, 51, 63, 69, 97, 6, 21, 52, 67, 74, 77, 97, 1, 14, 46, 48, 71, 97,
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	78, 97, 1, 3, 5, 7, 34, 35, 36, 37, 38, 39, 97 };

static const neuton_weights_num_t MODEL_INTERNAL_LINKS_BOUNDARIES[] = {
	0, 7, 13, 20, 27, 34, 39, 46, 52, 59, 64, 70, 78, 85, 90, 97, 104, 110,
	116, 123, 130, 136, 145, 150, 157, 165, 172, 175, 183, 190, 197, 204, 211,
	246, 253, 256, 264, 269, 277, 280, 296 };

static const neuton_weights_num_t MODEL_EXTERNAL_LINKS_BOUNDARIES[] = {
	6, 12, 19, 26, 33, 39, 45, 52, 58, 64, 70, 77, 84, 90, 97, 104, 110, 116,
	122, 129, 136, 142, 149, 155, 162, 168, 175, 182, 188, 195, 203, 210, 217,
	247, 254, 260, 267, 274, 280, 286, 297 };

static const neuton_coeff_t MODEL_ACTIVATION_COEFFS[] = {
	40919, 20504, 11427, 33307, 40958, 29362, 40958, 40960, 40960, 35183, 40922,
	40960, 40932, 39661, 40960, 40932, 40952, 40958, 40930, 40960, 40953, 40928,
	40960, 40960, 40960, 40824, 40932, 40955, 40955, 40958, 38406, 40955, 40932,
	40960, 26228, 35829, 39042, 12856, 40922, 40926, 40958 };

static const neuton_neurons_num_t MODEL_OUTPUT_NEURONS[] = { 33, 40 };

